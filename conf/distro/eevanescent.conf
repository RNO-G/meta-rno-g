## conf/distro/eevanescent.conf
```bitbake
require conf/distro/ampliphy.conf

DISTRO_VERSION:prepend = "EeVanescent-"
DISTRO = "eevanescent"
DISTRO_NAME = "EeVanescent Liνx"
VERSION_CODENAME="Shadow Zone"


DISTRO_FEATURES:remove = "wayland opengl usbgadget gpu"
DISTRO_FEATURES_BACKFILL_CONSIDERED += "x11"


VIRTUAL-RUNTIME_login_manager = "shadow"

VIRTUAL-RUNTIME_network_manager = "systemd-networkd"
VIRTUAL-RUNTIME_base-utils = "coreutils"


IMAGE_LINGUAS = "en-us"

DISTRO_FEATURE:append = " ldconfig usbhost"
PACKAGE_CLASSES = "package_rpm"

PREFERRED_PROVIDER_os-release = "eevanescent-version"
PACKAGE_CONFIG:systemd += "udev-hwdb"

INHERIT:remove = "create-spdx"
```

## conf/layer.conf
```bitbake
# We have a conf and classes directory, add to BBPATH
BBPATH .= ":${LAYERDIR}"

# We have recipes-* directories, add to BBFILES
BBFILES += "${LAYERDIR}/recipes-*/*/*.bb \
            ${LAYERDIR}/recipes-*/*/*.bbappend"

BBFILE_COLLECTIONS += "meta-rno-g"
BBFILE_PATTERN_meta-rno-g = "^${LAYERDIR}/"
BBFILE_PRIORITY_meta-rno-g = "60"

LAYERDEPENDS_meta-rno-g = "phytec openembedded-layer ampliphy"
LAYERSERIES_COMPAT_meta-rno-g = "scarthgap"
```

## conf/machine/rno-g-revn-k3r5.conf
```bitbake
#@TYPE: Machine
#@NAME: rno-g-revN-k3r5
#@DESCRIPTION: RNO-G Controller Board RevN with AM62x, 1-4 GB RAM
#@ARTICLENUMBERS: reVN

require conf/machine/include/phyam62xx-k3r5.inc

MACHINEOVERRIDES =. "k3r5-am62xx:rno-g-revn:"

SPL_BINARY = "tiboot3-am62x-hs-fs-phycore-som.bin"

UBOOT_MACHINE = ""
# Last config in the list is default
UBOOT_CONFIG = "ethboot usbdfu sd"
UBOOT_CONFIG[sd] = "phycore_am62x_r5_defconfig,sdcard"
UBOOT_CONFIG[usbdfu] = "phycore_am62x_r5_usbdfu_defconfig"
UBOOT_CONFIG[ethboot] = "phycore_am62x_r5_ethboot_defconfig"
```

## conf/machine/rno-g-revn.conf
```bitbake
#@TYPE: Machine
#@NAME: rno-g-rev-N
#@DESCRIPTION: RNO-G Controller Board RevN with AM62x, 1-4 GB RAM
#@ARTICLENUMBERS: revN

include conf/machine/include/phyam62xx.inc

MACHINEOVERRIDES =. ":rno-g-revn:"

MACHINE_FEATURES += "emmc 3g"

KERNEL_OVERLAYS = ""

KERNEL_DEVICETREE = " \
    ti/k3-am625-rno-g-revN.dtb \
    ${KERNEL_OVERLAYS} \
"

UBOOT_MACHINE = "phycore_am62x_a53_defconfig"
```
